#include <Wire.h>
#include <SPI.h>
#include <LoRa.h>
#include <Adafruit_GFX.h>
#include <Adafruit_SSD1306.h>
#include "Adafruit_VL6180X.h"

//Time of flight sensor definition
Adafruit_VL6180X vl = Adafruit_VL6180X();

// Range variable
uint8_t range;

//Screen definition
Adafruit_SSD1306 display = Adafruit_SSD1306();

#if (SSD1306_LCDHEIGHT != 32)
 #error("Height incorrect, please fix Adafruit_SSD1306.h!");
#endif

//LoRa parameters
int spreadFactor = 8;
int bwReference = 7;
int codingRate = 5;
byte syncWord = 0x12;
int preambleLength = 8;
int txPower = 17;

//Splash Screen in byte array
static const unsigned char PROGMEM  EC_Logo[] = {
  0xff, 0xff, 0xff, 0x01, 0xff, 0xff, 0xff, 0xff, 0xff, 0xff, 0xff, 0xff, 0x80, 0xff, 0xff, 0xff, 
  0xff, 0xff, 0xfe, 0x00, 0x1f, 0xff, 0xff, 0xff, 0xff, 0xff, 0xff, 0xf0, 0x00, 0x7f, 0xff, 0xff, 
  0xff, 0xff, 0xfc, 0x00, 0x03, 0xff, 0xff, 0xff, 0xff, 0xff, 0xff, 0x80, 0x00, 0x3f, 0xff, 0xff, 
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  0xff, 0xff, 0xff, 0xff, 0xff, 0xff, 0xf8, 0x00, 0x00, 0x1f, 0xff, 0xff, 0xff, 0xff, 0xff, 0xff
};

static const unsigned char PROGMEM SKULL[]= { 
  0xff, 0xff, 0xff, 0xff, 0xff, 0xff, 0xff, 0xff, 0xff, 0xff, 0xff, 0xff, 0xff, 0xff, 0xff, 0xff, 
  0xff, 0xff, 0xff, 0xff, 0xff, 0xff, 0xff, 0xfc, 0x00, 0x3f, 0xff, 0xff, 0xff, 0xff, 0xff, 0xff, 
  0xff, 0xff, 0xff, 0xff, 0xff, 0xff, 0xff, 0x01, 0xff, 0xc0, 0xff, 0xff, 0xff, 0xff, 0xff, 0xff, 
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  0xff, 0xff, 0xff, 0xff, 0xff, 0xfc, 0x99, 0x24, 0xff, 0xff, 0xff, 0xff, 0xff, 0xff, 0xff, 0xff
};
 
void setup() {
  Serial.begin(9600);

  //Initializating LoRa module on the BastWAN
  pinMode(RFM_TCX_ON,OUTPUT);
  pinMode(RFM_SWITCH,OUTPUT);
  pinMode(LED_BUILTIN,OUTPUT);
  LoRa.setPins(SS,RFM_RST,RFM_DIO0);
  if (!LoRa.begin(915E6)) {
    Serial.println("Starting LoRa failed!");
    while (1);
  }

  //Configuring the LoRa Parameters
  LoRa.setFrequency(915E6); //Set here the LoRa frequency
  LoRa.setSpreadingFactor(spreadFactor);
  LoRa.setSignalBandwidth(125E3);
  LoRa.setCodingRate4(codingRate);
  LoRa.setSyncWord(0x12);
  LoRa.setPreambleLength(8);
  //LoRa.enableInvertIQ();

  //Initializating the Screen
  if(!display.begin(SSD1306_SWITCHCAPVCC, 0x3C)) {
    Serial.println(F("SSD1306 allocation failed"));
    for(;;);
  }
  delay(2000); // Pause for 2 seconds
 
 //Initializating the TOF sensor
  Serial.println("Adafruit VL6180x test!");
  if (! vl.begin()) {
    Serial.println("Failed to find sensor");
    while (1);
  }
  Serial.println("Sensor found!");

  // Clear the buffer.
  display.clearDisplay();
  
  // Draw bitmap on the screen
  display.drawBitmap(0, 0, EC_Logo, 128, 32, 1);
  display.display();
  delay(1000);

  //Screen text settings
  display.setTextSize(2); // Draw 2X-scale text
  display.setTextColor(WHITE);

  display.clearDisplay();
  display.setCursor(0,0);
  display.println("  LoRa");
  display.print("configured");
  display.display();
  delay(1500);
  
  display.clearDisplay();
  display.setCursor(0,0);
  display.println("LoRa frq");
  display.print(frequency);
  display.print(" MHz");
  display.display();
  delay(1500);

}
 
void loop() {

range = vl.readRange();
uint8_t status = vl.readRangeStatus(); //Current status of the sensor

//Object detected in range
if (status == VL6180X_ERROR_NONE) {
  float ldnss = analogRead(A0);

  display.clearDisplay();
  display.setCursor(0,0);
  display.println("You are");
  display.println("too close");
  display.display();

  delay(1500);

  display.clearDisplay();
  display.setCursor(0,0);
  display.println("This close");
  display.print(range);
  display.print("mm");
  display.display();
  delay(1500);
  
  display.clearDisplay();
  display.setCursor(0,0);
  display.print("Distance \n and noise");
  display.display();
  delay(1500);
  display.clearDisplay();
  display.setCursor(0,0);
  display.print("lvls sent \n to master");
  display.display();
  delay(1500);
  
  digitalWrite(LED_BUILTIN,1);
  //Send packet
  LoRa.beginPacket();
  digitalWrite(RFM_SWITCH,0);
  LoRa.print("Distance: ");
  LoRa.print(range);
  LoRa.print(" mm; ");
  LoRa.print("Loudness: ");
  LoRa.print(ldnss);
  LoRa.endPacket();

  display.clearDisplay();
  display.setCursor(0,0);
  display.print("lvls sent \n to master");
  display.display();
  delay(1500);

  delay(2000);
  digitalWrite(LED_BUILTIN,0);
  delay(2000);

  display.clearDisplay();
  display.drawBitmap(0, 0, SKULL, 128, 32, 1);
  display.display();
  delay(2000);

  } 
  else {
  display.display();
  display.clearDisplay();
  return;
  }
}